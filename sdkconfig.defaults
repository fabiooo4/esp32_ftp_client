## sdkconfig.defaults
```kconfig
#
# Flash size
#
CONFIG_ESPTOOLPY_FLASHSIZE_4MB=y

#
# Partition Table
#
CONFIG_PARTITION_TABLE_CUSTOM=y
CONFIG_PARTITION_TABLE_CUSTOM_FILENAME="partitions.csv"
CONFIG_PARTITION_TABLE_FILENAME="partitions.csv"

#
# Stack size
#
CONFIG_ESP_MAIN_TASK_STACK_SIZE=5120
```
